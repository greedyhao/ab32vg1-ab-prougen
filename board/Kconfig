## board/Kconfig
```kconfig
menu "Hardware Drivers Config"

menu "Onboard Peripheral Drivers"

    config BSP_USING_USB_TO_USART
        bool "Enable USB TO USART (uart0)"
        select BSP_USING_UART
        select BSP_USING_UART0
        default y

    menuconfig BSP_USING_AUDIO
        bool "Enable Audio Device"
        select RT_USING_AUDIO
        default n

        if BSP_USING_AUDIO
            config BSP_USING_AUDIO_PLAY
            bool "Enable Audio Play"
            default y
        endif

endmenu

menu "On-chip Peripheral Drivers"

    menuconfig BSP_USING_UART0
        bool "Enable UART0"
        select RT_USING_SERIAL
        default y

    menuconfig BSP_USING_I2C1
        bool "Enable I2C1 BUS (software simulation)"
        default n
        select RT_USING_I2C
        select RT_USING_I2C_BITOPS
        select RT_USING_PIN
        if BSP_USING_I2C1
            comment "Notice: PE3 --> 16; PE2 --> 15"
            config BSP_I2C1_SCL_PIN
                int "I2C1 scl pin number"
                range 1 27
                default 16
            config BSP_I2C1_SDA_PIN
                int "I2C1 sda pin number"
                range 1 27
                default 15
        endif

endmenu

menu "Board extended module Drivers"
endmenu

endmenu
```
